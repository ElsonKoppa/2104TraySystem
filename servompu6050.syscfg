// These arguments were used when this file was generated. They will be automatically applied on subsequent loads 
// via the GUI or CLI invocations. Run CLI with '--help' for additional information on how to override these arguments.
// @cliArgs --board "/ti/boards/MSP_EXP432P401R" --product "simplelink_msp432p4_sdk@3.30.00.13"
// @versions {"data":"2019051709","timestamp":"2019051709","tool":"1.1.792","templates":"2019051709"}

var RTOS = scripting.addModule("/ti/drivers/RTOS");
var PWM = scripting.addModule("/ti/drivers/PWM");
var PWM1 = PWM.addInstance();
var PWM2 = PWM.addInstance();
var I2C = scripting.addModule("/ti/drivers/I2C");
var I2C1 = I2C.addInstance();
var Display = scripting.addModule("/ti/display/Display");
var Display1 = Display.addInstance();
var GPIO = scripting.addModule("/ti/drivers/GPIO");
var GPIO1 = GPIO.addInstance();
var GPIO2 = GPIO.addInstance();
// Name
RTOS.timer0.resource.$name = "MyTIMER_A1";
// Name - The C/C++ identifier used in applications as the index parameter passed to PWM runtime APIs
PWM1.$name = "CONFIG_PWM_0";
// Name
PWM1.timer.$name = "MyTIMER_A1";
// Assign pin
PWM1.timer.pwmPin.$assign = "boosterpack.37"; // P5.6
var Power = scripting.addModule("/ti/drivers/Power");
// Name
Power.performanceLevel3.$name = "ti_drivers_power_PowerMSP432PerfLevels0";
// Name
Power.performanceLevel2.$name = "ti_drivers_power_PowerMSP432PerfLevels1";
// Name
Power.performanceLevel1.$name = "ti_drivers_power_PowerMSP432PerfLevels2";
// Name
Power.performanceLevel0.$name = "ti_drivers_power_PowerMSP432PerfLevels3";
var Board = scripting.addModule("/ti/drivers/Board");
var DriverLib = scripting.addModule("/ti/devices/DriverLib");
// Name - The C/C++ identifier used in applications as the index parameter passed to PWM runtime APIs
PWM2.$name = "CONFIG_PWM_1";
// Use Hardware - Select the hardware to use, or 'none' to use available header pins
PWM2.$hardware = system.deviceData.board.components.LED2_BLUE;
// Name
PWM2.timer.$name = "MyTIMER_A1";
// Name - The C/C++ identifier used in applications as the index parameter passed to I2C runtime APIs
I2C1.$name = "CONFIG_I2C_0";
// Name
I2C1.i2c.$name = "MyI2C1";
// Name - The C/C++ identifier used in applications as the index parameter passed to Display runtime APIs
Display1.$name = "CONFIG_Display_0";
// Use Hardware - Select the hardware to use, or 'none' to use available header pins
Display1.$hardware = system.deviceData.board.components.XDS110UART;
// Name - The C/C++ identifier used in applications as the index parameter passed to UART runtime APIs
Display1.uart.$name = "CONFIG_UART_0";
// Name
Display1.uart.uart.$name = "MyUART1";
// Name - The C/C++ identifier used in applications as the index parameter passed to GPIO runtime APIs
GPIO1.$name = "CONFIG_GPIO_1";
// Use Hardware - Select the hardware to use, or 'none' to use available header pins
GPIO1.$hardware = system.deviceData.board.components.S1;
// Assign pin
GPIO1.gpioPin.$assign = "P1.1.GPIO/EUSCI_A0_SPI.CLK"; // pin number - 5
// Name - The C/C++ identifier used in applications as the index parameter passed to GPIO runtime APIs
GPIO2.$name = "CONFIG_GPIO_0";
// Use Hardware - Select the hardware to use, or 'none' to use available header pins
GPIO2.$hardware = system.deviceData.board.components.LED2_RED;
// Suggest solution
RTOS.timer0.resource.$suggestSolution = "Timer_A0";
// Suggest solution
PWM1.timer.$suggestSolution = "Timer_A2";
// Suggest solution
PWM2.timer.$suggestSolution = "Timer_A1";
// Suggest solution
PWM2.timer.pwmPin.$suggestSolution = "18";
// Suggest solution
I2C1.i2c.$suggestSolution = "EUSCI_B1";
// Suggest solution
I2C1.i2c.sdaPin.$suggestSolution = "78";
// Suggest solution
I2C1.i2c.sclPin.$suggestSolution = "79";
// Suggest solution
Display1.uart.uart.$suggestSolution = "EUSCI_A0";
// Suggest solution
Display1.uart.uart.txPin.$suggestSolution = "7";
// Suggest solution
Display1.uart.uart.rxPin.$suggestSolution = "6";
// Suggest solution
GPIO2.gpioPin.$suggestSolution = "16";
